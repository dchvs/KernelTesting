## meta-daniel/conf/layer.conf
```bitbake
# We have a conf and classes directory, append to BBPATH
BBPATH .= ":${LAYERDIR}"

# We have a recipes directory, add to BBFILES
BBFILES += "${LAYERDIR}/recipes*/*/*.bb ${LAYERDIR}/recipes*/*/*.bbappend ${LAYERDIR}/images/*.bb"



BBFILE_COLLECTIONS += "meta-daniel"
BBFILE_PATTERN_meta-daniel := "^${LAYERDIR}/recipes-daniel/libnl/ ^${LAYERDIR}/recipes-daniel/gtest/ ^${LAYERDIR}/recipes-daniel/ktf/ ^${LAYERDIR}/recipes-daniel/driver/ "
BBFILE_PRIORITY_meta-daniel = "16"

LAYERSERIES_COMPAT_meta-daniel = "warrior"
```

## meta-extra-config/conf/layer.conf
```bitbake
# We have a conf and classes directory, append to BBPATH
BBPATH .= ":${LAYERDIR}"

# We have a recipes directory, add to BBFILES
BBFILES += "${LAYERDIR}/recipes*/*/*.bb ${LAYERDIR}/recipes*/*/*.bbappend ${LAYERDIR}/images/*.bb"

BBFILE_COLLECTIONS += "meta-extra-config"
BBFILE_PATTERN_meta-extra-config := "^${LAYERDIR}/recipes-extra-config/*"
BBFILE_PRIORITY_meta-extra-config = "16"

LAYERSERIES_COMPAT_meta-extra-config = "warrior"
```

## meta-i2c-devs/conf/layer.conf
```bitbake
# We have a conf and classes directory, append to BBPATH
BBPATH .= ":${LAYERDIR}"

# We have a recipes directory, add to BBFILES
BBFILES += "${LAYERDIR}/recipes*/*/*.bb ${LAYERDIR}/recipes*/*/*.bbappend ${LAYERDIR}/images/*.bb"

BBFILE_COLLECTIONS += "meta-i2c-devs"
BBFILE_PATTERN_meta-i2c-devs := "^${LAYERDIR}/recipes-i2c-devs/*"
BBFILE_PRIORITY_meta-i2c-devs = "16"

LAYERSERIES_COMPAT_meta-i2c-devs = "warrior"
```

## yocto-rpi3-qemu/conf/bblayers.conf
```bitbake
# POKY_BBLAYERS_CONF_VERSION is increased each time build/conf/bblayers.conf
# changes incompatibly
POKY_BBLAYERS_CONF_VERSION = "2"

BBPATH = "${TOPDIR}"
BBFILES ?= " \
"

BBLAYERS ?= " \
		${TOPDIR}/../openembedded-core/meta \
		${TOPDIR}/../poky/meta-poky \
		${TOPDIR}/../meta-openembedded/meta-oe \
		${TOPDIR}/../meta-openembedded/meta-multimedia \
		${TOPDIR}/../meta-openembedded/meta-networking \
		${TOPDIR}/../meta-openembedded/meta-python \
		${TOPDIR}/../meta-raspberrypi \
		${TOPDIR}/../meta-ktf \
		${TOPDIR}/../meta-i2c-devices \
		${TOPDIR}/../meta-extra-config \
"
```
